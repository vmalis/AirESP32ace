## firmware/airspace-instrument/main/Kconfig.projbuild
```kconfig
# AirESP32ace
# Created by VM, August 2026

menu "AirESP32ace"

    config AIRSPACE_WIFI_SSID
        string "Wi-Fi SSID"
        default ""
        help
            Local Wi-Fi network name. Leave blank to keep Wi-Fi disconnected.

    config AIRSPACE_WIFI_PASSWORD
        string "Wi-Fi password"
        default ""
        help
            Local Wi-Fi password. Stored only in sdkconfig, which is gitignored in this project.

    config AIRSPACE_LOCATION_LABEL
        string "Location label"
        default "San Francisco"
        help
            Human-readable location shown on the diagnostics screen and used by future weather/radar screens.

    config AIRSPACE_LOCATION_LAT
        string "Location latitude"
        default "37.7749"

    config AIRSPACE_LOCATION_LON
        string "Location longitude"
        default "-122.4194"

    config AIRSPACE_TZ_POSIX
        string "POSIX timezone"
        default "PST8PDT,M3.2.0,M11.1.0"
        help
            POSIX TZ string used by localtime(). Default is Pacific time.

    config AIRSPACE_METAR_STATION
        string "Nearest METAR station"
        default "KSJC"
        help
            ICAO station used for aviation weather near the instrument.

    config AIRSPACE_RADAR_HALF_DEGREES
        string "Local radar bounding half-size in degrees"
        default "0.65"
        help
            OpenSky local aircraft query bounding box half-size around the configured location.

    config AIRSPACE_OPENSKY_ENABLE
        bool "Fetch nearby aircraft from OpenSky"
        default y
        help
            Uses OpenSky's public states endpoint as a best-effort source for nearby aircraft.

    config AIRSPACE_HTTP_USER_AGENT
        string "HTTP User-Agent"
        default "AirspaceInstrument/0.1 (personal ESP32 desk display)"
        help
            Public weather services ask clients to identify themselves.

endmenu
```

## firmware/airspace-instrument/sdkconfig.defaults
```kconfig
CONFIG_ESPTOOLPY_FLASHMODE_QIO=y
CONFIG_ESPTOOLPY_FLASHSIZE_32MB=y
CONFIG_PARTITION_TABLE_CUSTOM=y
CONFIG_COMPILER_OPTIMIZATION_PERF=y

CONFIG_SPIRAM=y
CONFIG_SPIRAM_MODE_OCT=y
CONFIG_SPIRAM_FETCH_INSTRUCTIONS=y
CONFIG_SPIRAM_RODATA=y
CONFIG_SPIRAM_SPEED_80M=y
CONFIG_SPIRAM_XIP_FROM_PSRAM=y
CONFIG_SPIRAM_TRY_ALLOCATE_WIFI_LWIP=y
CONFIG_SPIRAM_MALLOC_RESERVE_INTERNAL=98304

CONFIG_ESP32S3_INSTRUCTION_CACHE_32KB=y
CONFIG_ESP32S3_DATA_CACHE_64KB=y
CONFIG_ESP_DEFAULT_CPU_FREQ_MHZ_240=y
CONFIG_ESP32S3_DATA_CACHE_LINE_64B=y

CONFIG_FREERTOS_HZ=1000
CONFIG_ESP_MAIN_TASK_STACK_SIZE=8192

CONFIG_ESP_WIFI_STATIC_RX_BUFFER_NUM=2
CONFIG_ESP_WIFI_DYNAMIC_RX_BUFFER_NUM=8
CONFIG_ESP_WIFI_STATIC_TX_BUFFER=y
CONFIG_ESP_WIFI_DYNAMIC_TX_BUFFER=n
CONFIG_ESP_WIFI_STATIC_TX_BUFFER_NUM=4
CONFIG_ESP_WIFI_CACHE_TX_BUFFER_NUM=4
CONFIG_ESP_WIFI_MGMT_SBUF_NUM=8
CONFIG_ESP_WIFI_TX_BA_WIN=4
CONFIG_ESP_WIFI_RX_BA_WIN=4
CONFIG_ESP_WIFI_IRAM_OPT=n
CONFIG_ESP_WIFI_RX_IRAM_OPT=n

CONFIG_MBEDTLS_EXTERNAL_MEM_ALLOC=y
CONFIG_MBEDTLS_DYNAMIC_BUFFER=y

CONFIG_LV_USE_CLIB_MALLOC=y
CONFIG_LV_USE_CLIB_STRING=y
CONFIG_LV_USE_CLIB_SPRINTF=y
CONFIG_LV_DEF_REFR_PERIOD=15
CONFIG_LV_OS_FREERTOS=y
CONFIG_LV_OBJ_STYLE_CACHE=y
CONFIG_LV_DRAW_SW_DRAW_UNIT_CNT=1
CONFIG_LV_ATTRIBUTE_FAST_MEM_USE_IRAM=y
CONFIG_LV_FONT_MONTSERRAT_12=y
CONFIG_LV_FONT_MONTSERRAT_16=y
CONFIG_LV_FONT_MONTSERRAT_18=y
CONFIG_LV_FONT_MONTSERRAT_20=y
CONFIG_LV_FONT_MONTSERRAT_24=y
CONFIG_LV_FONT_MONTSERRAT_28=y
CONFIG_LV_FONT_MONTSERRAT_32=y
CONFIG_LV_FONT_MONTSERRAT_40=y
CONFIG_LV_FONT_MONTSERRAT_48=y
CONFIG_LV_USE_QRCODE=y
CONFIG_LV_GRADIENT_MAX_STOPS=4
CONFIG_LV_USE_FONT_COMPRESSED=y
CONFIG_LV_USE_SNAPSHOT=y

CONFIG_BSP_LCD_TRANS_QUEUE_DEPTH=1
CONFIG_BSP_LCD_BUFFER_HEIGHT=6
```
